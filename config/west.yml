## config/west.yml
```yaml
#manifest:
#  remotes:
#    - name: zmkfirmware
#      url-base: https://github.com/zmkfirmware
#    - name: urob
#      url-base: https://github.com/urob
#  projects:
#    - name: zmk
#      remote: zmkfirmware
#      remote: urob
#      revision: main
#      import: app/west.yml
#  self:
#    path: config

manifest:
  defaults:
    remote: urob
    revision: v0.2 # Pin everything to v0.2

  remotes:
    - name: urob
      url-base: https://github.com/urob
    - name: zmkfirmware
      url-base: https://github.com/zmkfirmware

  projects:
    # This is vanilla ZMK - just using my remote to pin the current state of main,
    # as upstream hasn't yet released a version with mouse.
    - name: zmk
      remote: zmkfirmware
      import: app/west.yml
```
